## boards/shields/adept/Kconfig.defconfig
```kconfig
if SHIELD_ADEPT_BOARD

config ZMK_POINTING
    default y

config ZMK_KEYBOARD_NAME
	default "Kai Adept"

config SPI
    default y

endif
```

## boards/shields/adept/Kconfig.shield
```kconfig
# No whitespace after the comma or in your part name!

config SHIELD_ADEPT_BOARD
    def_bool $(shields_list_contains,adept_board)
```
